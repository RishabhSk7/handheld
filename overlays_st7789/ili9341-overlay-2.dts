/dts-v1/;
/plugin/;

/ {
    compatible = "brcm,bcm2711";

    fragment@0 {
        target = <&spi0>;
        __overlay__ {
            status = "okay";
            #address-cells = <1>;
            #size-cells = <0>;

            ili9341@0 {
    compatible = "fbtft,ili9341";
    reg = <0>;
    spi-max-frequency = <8000000>;
    dc-gpios = <&gpio 24 0>;
    reset-gpios = <&gpio 25 0>;
    rotate = <90>;
    buswidth = <8>;
};
        };
    };

    fragment@1 {
        target = <&spidev0>;
        __overlay__ { status = "disabled"; };
    };
};
