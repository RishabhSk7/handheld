/dts-v1/;
/plugin/;

/ {
    compatible = "brcm,bcm2711";

    fragment@0 {
        target = <&spi0>;
        __overlay__ {
            status = "okay";
            #address-cells = <1>;
            #size-cells = <0>;

            st7789v@0 {
                compatible = "sitronix,st7789v";
                reg = <0>;
                spi-max-frequency = <8000000>;

                dc-gpios = <&gpio 24 0>;
                reset-gpios = <&gpio 25 1>;

                rotation = <90>;

                width = <240>;
                height = <320>;
                buswidth = <8>;
            };
        };
    };

    fragment@1 {
        target = <&spidev0>;
        __overlay__ {
            status = "disabled";
        };
    };
};
