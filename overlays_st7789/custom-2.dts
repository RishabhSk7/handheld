/dts-v1/;
/plugin/;

/ {
    compatible = "brcm,bcm2711";

    fragment@0 {
        target = <&spi0>;
        __overlay__ {
            #address-cells = <1>;
            #size-cells = <0>;
            status = "okay";

            st7789v: st7789v@0 {
                compatible = "sitronix,st7789v";
                reg = <0>;
                spi-max-frequency = <64000000>;

                reset-gpios = <&gpio 25 0>;
                dc-gpios    = <&gpio 24 0>;
                rotation    = <90>;
            };
        };
    };

    /*
    fragment@1 {
        target-path = "/";
        __overlay__ {
            backlight: backlight {
                compatible = "gpio-backlight";
                gpios = <&gpio 18 0>;
                default-on;
            };
        };
    };*/

    fragment@2 {
        target = <&spidev0>;
        __overlay__ { status = "disabled"; };
    };
};
