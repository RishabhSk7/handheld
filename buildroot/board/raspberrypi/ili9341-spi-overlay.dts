/dts-v1/;
/plugin/;

/ {
    compatible = "brcm,bcm2711";

    fragment@0 {
        target = <&spi0>;
        __overlay__ {

            status = "okay";

            #address-cells = <1>;
            #size-cells = <0>;

            ili9341: ili9341@0 {
                compatible = "ilitek,ili9341";
                reg = <0>;                      /* CS0 */
                spi-max-frequency = <32000000>;

                dc-gpios = <&gpio 25 0>;
                reset-gpios = <&gpio 24 0>;
                rotation = <0>;
                bgr;
                status = "okay";
            };
        };
    };
};
