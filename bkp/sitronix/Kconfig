## bkp/sitronix/Kconfig
```kconfig
config DRM_ST7789V
	tristate "DRM support for Sitronix ST7789V display panels"
	depends on DRM && SPI
	select DRM_GEM_DMA_HELPER
	select DRM_KMS_HELPER
	select DRM_MIPI_DBI
	select BACKLIGHT_CLASS_DEVICE
	help
	  DRM driver for Sitronix ST7789V panels connected via SPI.
```

## buildroot/output/build/linux-custom/drivers/gpu/drm/sitronix/Kconfig
```kconfig
# SPDX-License-Identifier: GPL-2.0-only

config DRM_ST7789V
	tristate "DRM support for Sitronix ST7789V display panels"
	depends on DRM && SPI
	select DRM_GEM_DMA_HELPER
	select DRM_KMS_HELPER
	select DRM_MIPI_DBI
	select BACKLIGHT_CLASS_DEVICE
	help
	  DRM driver for Sitronix ST7789V panels connected via SPI.

	  If M is selected the module will be called st7789v.
```

## buildroot/package/fbcp-ili9341/Config.in
```kconfig
config BR2_PACKAGE_FBCP_ILI9341
	bool "fbcp-ili9341"
	help
	  High performance framebuffer copy to SPI displays.
```

## buildroot/package/retroarch/Config.in
```kconfig
config BR2_PACKAGE_RETROARCH
	bool "retroarch"
	help
		RetroArch frontend for liberto
```
